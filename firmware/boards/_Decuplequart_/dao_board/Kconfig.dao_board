## firmware/boards/_Decuplequart_/dao_board/board.yml
```yaml
board:
  name: dao_board
  full_name: dao_board
  vendor: _Decuplequart_
  socs:
    - name: nrf52840
```

## firmware/boards/decuplequart/dao_board/board.yml
```yaml
board:
  name: dao_board
  full_name: dao_board
  vendor: decuplequart
  socs:
    - name: nrf52840
```
